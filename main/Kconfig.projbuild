## main/Kconfig.projbuild
```kconfig
menu "Gestures Configuration"

    orsource "$IDF_PATH/examples/common_components/env_caps/$IDF_TARGET/Kconfig.env_caps"

    config I2C_DISPLAY_ADDRESS
        hex "Display I2C Address"
        range 0x00 0x7F
        default 0x3C
        help
            I2C address of the target display, usually 0x3C or 0x3D.

    config I2C_VL53L8CX_ADDRESS
        hex "VL53L8CX I2C Address"
        range 0x00 0x7F
        default 0x40
        help
            I2C address of the INA219 sensor

    config I2C_MASTER_SCL
        int "SCL GPIO Num"
        range ENV_GPIO_RANGE_MIN ENV_GPIO_OUT_RANGE_MAX
        default 19 if IDF_TARGET_ESP32
        default 19
        help
            GPIO number for I2C Master clock line.

    config I2C_MASTER_SDA
        int "SDA GPIO Num"
        range ENV_GPIO_RANGE_MIN ENV_GPIO_OUT_RANGE_MAX
        default 20 if IDF_TARGET_ESP32
        default 20
        help
            GPIO number for I2C Master data line.

    config I2C_MASTER_FREQUENCY
        int "Master Frequency"
        default 1000000
        help
            I2C Speed of Master device.

    config I2C_MASTER_TIMEOUT_MS
        int "Master read/write timeout, in ms"
        default 1000
        help
            I2C Timeout of Master device.
endmenu
```
